## conf/bblayers.conf
```bitbake
# POKY_BBLAYERS_CONF_VERSION is increased each time build/conf/bblayers.conf
# changes incompatibly
POKY_BBLAYERS_CONF_VERSION = "2"

BBPATH = "${TOPDIR}"
BBFILES ?= ""

BBLAYERS ?= " \
  /home/samuel/Development/repos/pitrac-yocto/layers/poky/meta \
  /home/samuel/Development/repos/pitrac-yocto/layers/poky/meta-poky \
  /home/samuel/Development/repos/pitrac-yocto/layers/poky/meta-yocto-bsp \
  /home/samuel/Development/repos/pitrac-yocto/layers/meta-openembedded/meta-oe \
  /home/samuel/Development/repos/pitrac-yocto/layers/meta-openembedded/meta-python \
  /home/samuel/Development/repos/pitrac-yocto/layers/meta-openembedded/meta-networking \
  /home/samuel/Development/repos/pitrac-yocto/layers/meta-raspberrypi \
  "
```
